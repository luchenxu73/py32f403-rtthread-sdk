## tools/package/Kconfig
```kconfig
menuconfig PKG_USING_PY32F403_SDK
    bool "PY32F403 SDK (Device and HAL)"
    select PKG_USING_CMSIS_CORE
    default n

if PKG_USING_PY32F403_SDK
    config PKG_PY32F403_SDK_PATH
        string
        default "/packages/peripherals/hal-sdk/puya/py32f403_sdk"

    choice
        prompt "Version"
        default PKG_USING_PY32F403_SDK_LATEST_VERSION
        config PKG_USING_PY32F403_SDK_LATEST_VERSION
            bool "latest"
    endchoice

    config PKG_PY32F403_SDK_VER
        string
        default "latest" if PKG_USING_PY32F403_SDK_LATEST_VERSION
endif
```

## tools/package/Kconfig.puya
```kconfig
menu "PUYA HAL & SDK Drivers"

source "$PKGS_DIR/packages/peripherals/hal-sdk/puya/py32f403_sdk/Kconfig"

endmenu
```
